## firmware/sdkconfig.defaults
```kconfig
# Silent Caption ESP32-WROOM-32 baseline.
# ESP-IDF: v5.5.5 (see firmware/IDF_VERSION)
CONFIG_IDF_TARGET="esp32"
CONFIG_BT_ENABLED=y
CONFIG_BT_BLUEDROID_ENABLED=y
CONFIG_BT_CLASSIC_ENABLED=y
CONFIG_BT_A2DP_ENABLE=y
```
